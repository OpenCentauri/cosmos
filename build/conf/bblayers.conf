## build/conf/bblayers.conf
```bitbake
# POKY_BBLAYERS_CONF_VERSION is increased each time build/conf/bblayers.conf
# changes incompatibly
POKY_BBLAYERS_CONF_VERSION = "2"

BBPATH = "${TOPDIR}"
BBFILES ?= ""

BBLAYERS ?= "   /home/builder/opencentauri-repo/poky/meta   /home/builder/opencentauri-repo/poky/meta-poky   /home/builder/opencentauri-repo/poky/meta-yocto-bsp   /home/builder/opencentauri-repo/meta-arm/meta-arm-toolchain   /home/builder/opencentauri-repo/meta-arm/meta-arm   /home/builder/opencentauri-repo/meta-openembedded/meta-oe   /home/builder/opencentauri-repo/meta-openembedded/meta-networking   /home/builder/opencentauri-repo/meta-openembedded/meta-python   /home/builder/opencentauri-repo/meta-sunxi   /home/builder/opencentauri-repo/meta-swupdate   /home/builder/opencentauri-repo/meta-opencentauri   "
```

## meta-opencentauri/conf/distro/cosmos.conf
```bitbake
require conf/distro/poky.conf

DISTRO = "cosmos"
DISTRO_NAME = "OpenCentauri Cosmos"
DISTRO_VERSION = "26.09.0"

DISTROOVERRIDES = "opencentauri"

MAINTAINER = "James Turton <james.turton@gmx.com>"

PACKAGE_CLASSES = "package_ipk"
DISTRO_FEATURES:remove = "ptest"

DISTRO_FEATURES:append = " rust"

EXTRA_IMAGE_FEATURES ?= "allow-empty-password empty-root-password allow-root-login post-install-logging"

IMAGE_NAME_SUFFIX = ""

INHERIT += "buildstats"
INHERIT_DISTRO:remove = "create-spdx"

PATCHRESOLVE = "noop"

PACKAGECONFIG:append:pn-qemu-system-native = " sdl"

ERROR_QA:remove = "patch-status"

PREFERRED_VERSION_linux-mainline = "7.2.9"

PREFERRED_VERSION_python3 = "3.15.%"
PREFERRED_VERSION_python3-native = "3.15.%"
PREFERRED_VERSION_nativesdk-python3 = "3.15.%"
PYTHON_BASEVERSION:opencentauri = "3.15"
```
