## meta-opencentauri/conf/distro/kosmos.conf
```bitbake
require conf/distro/poky.conf

DISTRO = "kosmos"
DISTRO_NAME = "OpenCentauri Kosmos"
DISTRO_VERSION = "0.0.2"

MAINTAINER = "James Turton <james.turton@gmx.com>"

PACKAGE_CLASSES = "package_ipk"
DISTRO_FEATURES:remove = "ptest"

DISTRO_FEATURES:append = " rust"
RUST_VERSION = "1.92.0"
CARGO_VERSION = "1.92.0"
```

## meta-opencentauri/conf/layer.conf
```bitbake
# We have a conf and classes directory, add to BBPATH
BBPATH .= ":${LAYERDIR}"

# We have recipes-* directories, add to BBFILES
BBFILES += "${LAYERDIR}/recipes-*/*/*.bb \
            ${LAYERDIR}/recipes-*/*/*.bbappend"

BBFILE_COLLECTIONS += "meta-opencentauri"
BBFILE_PATTERN_meta-opencentauri = "^${LAYERDIR}/"
BBFILE_PRIORITY_meta-opencentauri = "6"

LAYERDEPENDS_meta-opencentauri = "core sunxi"
LAYERSERIES_COMPAT_meta-opencentauri = "scarthgap"
```

## meta-opencentauri/conf/machine/elegoo-centauri-carbon1.conf
```bitbake
#@TYPE: Machine
#@NAME: Elegoo Centauri Carbon 1
#@DESCRIPTION: Machine configuration for the Elegoo Centauri Carbon 1, based on the Allwinner R528 CPU

require conf/machine/include/sun8i.inc

DEFAULTTUNE = "cortexa7thf-neon-vfpv4"

KERNEL_DEVICETREE = "allwinner/elegoo-centauri-carbon1.dtb"
KERNEL_IMAGETYPE = "zImage"
UBOOT_ENTRYPOINT = "0x43000000"
SERIAL_CONSOLES = "115200;ttyS0"

UBOOT_MACHINE = "elegoo_centauri_carbon1_defconfig"
```

## meta-opencentauri/conf/machine/elegoo-centauri-carbon2.conf
```bitbake
#@TYPE: Machine
#@NAME: Elegoo Centauri Carbon 2
#@DESCRIPTION: Machine configuration for the Elegoo Centauri Carbon 2, based on the Allwinner R528 CPU

require conf/machine/include/sun8i.inc

DEFAULTTUNE = "cortexa7thf-neon-vfpv4"

KERNEL_DEVICETREE = "allwinner/elegoo-centauri-carbon2.dtb"
KERNEL_IMAGETYPE = "zImage"
UBOOT_ENTRYPOINT = "0x43000000"
SERIAL_CONSOLES = "ttyS2,115200"
SERIAL_ADDR = "0x02500800"

UBOOT_MACHINE = "elegoo_centauri_carbon2_defconfig"
```

## meta-opencentauri/recipes-bsp/u-boot/files/elegoo-centauri-carbon2/elegoo_centauri_carbon_defconfig
```kconfig
CONFIG_ARM=y
CONFIG_ARCH_SUNXI=y
CONFIG_DEFAULT_DEVICE_TREE="elegoo-centauri-carbon"
CONFIG_SPL=y
CONFIG_MACH_SUN8I_R528=y
CONFIG_DRAM_CLK=792
CONFIG_DRAM_ZQ=8092667
CONFIG_SUNXI_MINIMUM_DRAM_MB=128
# CONFIG_SYS_MALLOC_CLEAR_ON_INIT is not set
CONFIG_DRAM_SUNXI_ODT_EN=0
CONFIG_DRAM_SUNXI_TPR0=0x004a2195
CONFIG_DRAM_SUNXI_TPR11=0x340000
CONFIG_DRAM_SUNXI_TPR12=0x46
CONFIG_DRAM_SUNXI_TPR13=0x34000100
CONFIG_CONS_INDEX=1
#CONFIG_DEBUG_UART=y
#CONFIG_DEBUG_UART_8250=y
#CONFIG_DEBUG_UART_BASE=0x02500000
#CONFIG_DEBUG_UART_CLOCK=24000000
#CONFIG_DEBUG_UART_8250_WORD=y
#CONFIG_DEBUG_UART_8250_SHIFT=2
#CONFIG_DEBUG_UART_ANNOUNCE=y
#CONFIG_USB_HOST=y
CONFIG_USB_EHCI_HCD=y
CONFIG_USB_OHCI_HCD=y
CONFIG_CMD_USB=y
CONFIG_BOOTDELAY=3
CONFIG_USE_BOOTARGS=y
CONFIG_BOOTARGS="console=ttyS0,115200 earlycon=uart8250,mmio32,0x02500000 root=/dev/sda2 rootwait"
CONFIG_USE_BOOTCOMMAND=y
CONFIG_BOOTCOMMAND="fatload usb 0:1 43000000 zImage; fatload usb 0:1 43800000 elegoo-centauri-carbon.dtb; bootz 43000000 - 43800000"
CONFIG_PREBOOT="load mmc 0:1 0x43000000 bootlogo.bmp; bmp display 0x43000000; usb start"

# Display / splash screen
CONFIG_VIDEO=y
CONFIG_DM_VIDEO=y
CONFIG_VIDEO_DE2=y
CONFIG_VIDEO_DT_SIMPLEFB=y
CONFIG_DISPLAY=y
CONFIG_VIDEO_LCD_IF_PARALLEL=y
CONFIG_VIDEO_LCD_DCLK_PHASE=0
CONFIG_VIDEO_MIPI_DSI=y
CONFIG_VIDEO_DW_MIPI_DSI=y
CONFIG_VIDEO_SIMPLE=y
CONFIG_SPLASH_SCREEN=y
CONFIG_SPLASH_SCREEN_ALIGN=y
CONFIG_BACKLIGHT_GPIO=y
CONFIG_BMP=y
CONFIG_BMP_16BPP=y
CONFIG_BMP_24BPP=y
CONFIG_BMP_32BPP=y
CONFIG_CMD_BMP=y

CONFIG_SPL_LOG=y
CONFIG_SPL_LOG_MAX_LEVEL=7
CONFIG_SPL_LOG_CONSOLE=y
CONFIG_SPL_STACK_R_ADDR=0x47e00000
```

## meta-opencentauri/recipes-bsp/u-boot/files/elegoo_centauri_carbon1_defconfig
```kconfig
CONFIG_ARM=y
CONFIG_ARCH_SUNXI=y
CONFIG_DEFAULT_DEVICE_TREE="elegoo-centauri-carbon1"
CONFIG_SPL=y
CONFIG_MACH_SUN8I_R528=y
CONFIG_DRAM_CLK=792
CONFIG_DRAM_ZQ=8092667
CONFIG_SUNXI_MINIMUM_DRAM_MB=128
# CONFIG_SYS_MALLOC_CLEAR_ON_INIT is not set
CONFIG_DRAM_SUNXI_ODT_EN=0
CONFIG_DRAM_SUNXI_TPR0=0x004a2195
CONFIG_DRAM_SUNXI_TPR11=0x340000
CONFIG_DRAM_SUNXI_TPR12=0x46
CONFIG_DRAM_SUNXI_TPR13=0x34000100
CONFIG_CONS_INDEX=1
#CONFIG_DEBUG_UART=y
#CONFIG_DEBUG_UART_8250=y
#CONFIG_DEBUG_UART_BASE=0x02500000
#CONFIG_DEBUG_UART_CLOCK=24000000
#CONFIG_DEBUG_UART_8250_WORD=y
#CONFIG_DEBUG_UART_8250_SHIFT=2
#CONFIG_DEBUG_UART_ANNOUNCE=y
#CONFIG_USB_HOST=y
CONFIG_USB_EHCI_HCD=y
CONFIG_USB_OHCI_HCD=y
CONFIG_CMD_USB=y
# CONFIG_BOOTDELAY=3
# CONFIG_USE_BOOTARGS=y
# CONFIG_BOOTARGS="console=ttyS0,115200 earlycon=uart8250,mmio32,0x02500000 root=/dev/sda2 rootwait"
# CONFIG_USE_BOOTCOMMAND=y
# CONFIG_BOOTCOMMAND="fatload usb 0:1 43000000 zImage; fatload usb 0:1 43800000 elegoo-centauri-carbon1.dtb; bootz 43000000 - 43800000"

# Display / splash screen
CONFIG_VIDEO=y
CONFIG_DM_VIDEO=y
CONFIG_VIDEO_DE2=y
CONFIG_VIDEO_DT_SIMPLEFB=y
CONFIG_DISPLAY=y
CONFIG_VIDEO_LCD_IF_PARALLEL=y
CONFIG_VIDEO_LCD_DCLK_PHASE=0
CONFIG_SPLASH_SCREEN=y
CONFIG_SPLASH_SCREEN_ALIGN=y
CONFIG_BACKLIGHT_GPIO=y
CONFIG_BMP=y
CONFIG_BMP_16BPP=y
CONFIG_BMP_24BPP=y
CONFIG_BMP_32BPP=y
CONFIG_CMD_BMP=y

CONFIG_SPL_LOG=y
CONFIG_SPL_LOG_MAX_LEVEL=7
CONFIG_SPL_LOG_CONSOLE=y
CONFIG_SPL_STACK_R_ADDR=0x47e00000

CONFIG_ENV_SOURCE_FILE="elegoo-centauri-carbon1"
CONFIG_ENV_SIZE=0x20000
CONFIG_ENV_OFFSET=0x1A66000
CONFIG_ENV_OFFSET_REDUND=0x1AA5000
# CONFIG_ENV_IS_IN_FAT is not set
CONFIG_ENV_IS_IN_MMC=y
CONFIG_SYS_REDUNDAND_ENVIRONMENT=y
# CONFIG_USE_ENV_MMC_PARTITION is not set
# CONFIG_ENV_MMC_USE_DT is not set
```
